## meta-berge/conf/layer.conf
```bitbake
# meta-berge/conf/layer.conf

BBPATH .= ":${LAYERDIR}"
BBFILES += "${LAYERDIR}/recipes-*/*/*.bb \
            ${LAYERDIR}/recipes-*/*/*.bbappend"

BBFILE_COLLECTIONS += "berge"
BBFILE_PATTERN_berge = "^${LAYERDIR}/"
LAYERSERIES_COMPAT_berge = "scarthgap"
BBFILE_PRIORITY_berge = "122"
```
